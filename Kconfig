## examples/sld_demo_s3_bt817/main/Kconfig.projbuild
```kconfig
menu "SLD Demo configuration"

    config SLD_C_W_S3_BT817
        bool "Use SLD_C_W_S3_BT817 board instead of SLD_C_W_S3"
        default n
        help
            Set this, when using the SLD_C_W_S3_BT817 board instead of SLD_C_W_S3.

    config SLD_DEMO_WEBSERVER_PORT
        int "Webserver port"
        default 80
        help
            Set this to the webserver port you want to use.

    config SLD_DEMO_WIFI_SSID
        string "WiFi SSID"
        default ""
        help
            Set this to the WiFi SSID you want to connect to.

    config SLD_DEMO_WIFI_PASSWORD
        string "WiFi Password"
        default ""
        help
            Set this to the WiFi password you want to connect to.

    config SLD_DEMO_WIFI_AP_ENABLE
        bool "Enable WiFi hotspot"
        default y
        help
            Set this to enable the WiFi hotspot.
            This will create a hotspot with the SSID "SLD_DEMO_WIFI_HOTSPOT"

    config SLD_DEMO_WIFI_AP_SSID
        depends on SLD_DEMO_WIFI_AP_ENABLE
        string "WiFi hotspot SSID"
        default "SLD_DEMO_WIFI_AP_SSID"
        help
            Set this to the WiFi hotspot SSID you want to create.

    config SLD_DEMO_WIFI_AP_PASSWORD
        depends on SLD_DEMO_WIFI_AP_ENABLE
        string "WiFi hotspot Password"
        default "12345678"
        help
            Set this to the WiFi hotspot password you want to create.

    choice EXAMPLE_VIDEO_BUFFER_TYPE
        prompt "Video Buffer Type"
        default EXAMPLE_VIDEO_BUFFER_TYPE_USER
        help
            Select video buffer type:
            
            - User buffer, users should allocate and free the buffer manually
            - Driver buffer, drivers allocate and free the buffer automatically

        config EXAMPLE_VIDEO_BUFFER_TYPE_USER
            bool "User Buffer"

        config EXAMPLE_VIDEO_BUFFER_TYPE_DRIVER
            bool "Driver Buffer"
    endchoice

endmenu
```

## examples/sld_demo_s3_lvgl/sdkconfig.defaults
```kconfig
CONFIG_LV_COLOR_DEPTH_24=y
CONFIG_LV_FONT_MONTSERRAT_10=y
CONFIG_LV_FONT_MONTSERRAT_14=y
CONFIG_LV_FONT_MONTSERRAT_24=y

CONFIG_MCU_PERIPHERY_ENABLE_WIFI=y

CONFIG_MODULE_ENABLE_DISPLAY=y

CONFIG_DEBUG_CONSOLE_TEST_PASSWORD="KameSennin@ESoPe-1337"

#
# Module/Display Configuration
#
CONFIG_DISPLAY_ENABLE_SLD=y
# end of Module/Display Configuration

CONFIG_MODULE_ENABLE_EEPROM=y
CONFIG_MODULE_ENABLE_LCD_TOUCH=y
CONFIG_MODULE_ENABLE_LCD_TOUCH_DRIVER_ST1633I=y

CONFIG_ESPTOOLPY_FLASHMODE_QIO=y
#
# Partition Table
#
# CONFIG_PARTITION_TABLE_SINGLE_APP is not set
# CONFIG_PARTITION_TABLE_SINGLE_APP_LARGE is not set
# CONFIG_PARTITION_TABLE_TWO_OTA is not set
# CONFIG_PARTITION_TABLE_TWO_OTA_LARGE is not set
CONFIG_PARTITION_TABLE_CUSTOM=y
CONFIG_PARTITION_TABLE_CUSTOM_FILENAME="partitions.csv"
CONFIG_PARTITION_TABLE_FILENAME="partitions.csv"
CONFIG_PARTITION_TABLE_OFFSET=0x8000
CONFIG_PARTITION_TABLE_MD5=y
# end of Partition Table

CONFIG_ESPTOOLPY_FLASHSIZE_16MB=y

CONFIG_ESP_TASK_WDT_INIT=n
```

## examples/sld_demo_s3_lvgl/sdkconfig.defaults.esp32p4
```kconfig
CONFIG_IDF_EXPERIMENTAL_FEATURES=y

CONFIG_SPIRAM=y
CONFIG_SPIRAM_SPEED_200M=y
CONFIG_SPIRAM_SPEED=200
CONFIG_SPIRAM_ECC_ENABLE=y

CONFIG_ESP_MAIN_TASK_STACK_SIZE=8192

CONFIG_ESP_CONSOLE_UART_BAUDRATE=500000
CONFIG_ESP_CONSOLE_UART_CUSTOM_NUM_0=y
CONFIG_ESP_CONSOLE_UART_TX_GPIO=37
CONFIG_ESP_CONSOLE_UART_RX_GPIO=38
CONFIG_ESPTOOLPY_MONITOR_BAUD=500000

CONFIG_ESP_WIFI_STATIC_RX_BUFFER_NUM=16
CONFIG_ESP_WIFI_DYNAMIC_RX_BUFFER_NUM=64
CONFIG_ESP_WIFI_TX_BUFFER_TYPE=0
CONFIG_ESP_WIFI_STATIC_TX_BUFFER_NUM=16
CONFIG_ESP_WIFI_CACHE_TX_BUFFER_NUM=32
CONFIG_ESP_WIFI_RX_BA_WIN=32

CONFIG_LWIP_LOCAL_HOSTNAME="sld_demo"
CONFIG_LWIP_TCPIP_RECVMBOX_SIZE=64
#CONFIG_LWIP_TCP_SND_BUF_DEFAULT=65534
#CONFIG_LWIP_TCP_WND_DEFAULT=65534
CONFIG_LWIP_TCP_SND_BUF_DEFAULT=5760
CONFIG_LWIP_TCP_WND_DEFAULT=5760
CONFIG_LWIP_TCP_RECVMBOX_SIZE=64
CONFIG_LWIP_TCP_SACK_OUT=y
CONFIG_LWIP_UDP_RECVMBOX_SIZE=64

# eppp_link
#
CONFIG_EPPP_LINK_USES_LWIP=y
CONFIG_EPPP_LINK_DEVICE_UART=y
# CONFIG_EPPP_LINK_DEVICE_SPI is not set
# CONFIG_EPPP_LINK_DEVICE_SDIO is not set
CONFIG_EPPP_LINK_CONN_MAX_RETRY=6
# end of eppp_link

CONFIG_ESP_HOSTED_ENABLED=y

#
# ESP-Hosted config
#

#
# ESP32-C6 is Slave Target from Wi-Fi Remote Component
#
CONFIG_ESP_HOSTED_PRIV_SDIO_OPTION=y
CONFIG_ESP_HOSTED_PRIV_SPI_HD_OPTION=y
CONFIG_ESP_HOSTED_SDIO_HOST_INTERFACE=y
CONFIG_ESP_HOSTED_IDF_SLAVE_TARGET="esp32c6"

#
# Hosted SDIO Configuration
#
CONFIG_ESP_HOSTED_SDIO_SLOT_0=y
CONFIG_ESP_HOSTED_SDIO_SLOT_1=n
CONFIG_ESP_HOSTED_SDIO_SLOT=0
CONFIG_ESP_HOSTED_SDIO_RESET_ACTIVE_HIGH=n
CONFIG_ESP_HOSTED_SDIO_RESET_ACTIVE_LOW=y
CONFIG_ESP_HOSTED_SDIO_OPTIMIZATION_RX_STREAMING_MODE=y
CONFIG_ESP_HOSTED_SDIO_GPIO_RESET_SLAVE=46
CONFIG_ESP_HOSTED_SDIO_4_BIT_BUS=y
CONFIG_ESP_HOSTED_SDIO_BUS_WIDTH=4
CONFIG_ESP_HOSTED_SDIO_CLOCK_FREQ_KHZ=40000
CONFIG_ESP_HOSTED_SDIO_PIN_CMD=44
CONFIG_ESP_HOSTED_SDIO_PIN_CLK=43
CONFIG_ESP_HOSTED_SDIO_PIN_D0=39
CONFIG_ESP_HOSTED_SDIO_PRIV_PIN_D1_4BIT_BUS=40
CONFIG_ESP_HOSTED_SDIO_PIN_D2=41
CONFIG_ESP_HOSTED_SDIO_PIN_D3=42
CONFIG_ESP_HOSTED_SDIO_PIN_D1=40
CONFIG_ESP_HOSTED_SDIO_TX_Q_SIZE=20
CONFIG_ESP_HOSTED_SDIO_RX_Q_SIZE=20
# end of Hosted SDIO Configuration

CONFIG_ESP_HOSTED_GPIO_SLAVE_RESET_SLAVE=-1

#
# Task defaults
#
CONFIG_ESP_HOSTED_RPC_TASK_STACK=4096
CONFIG_ESP_HOSTED_DFLT_TASK_STACK=3072
# end of Task defaults

CONFIG_ESP_HOSTED_USE_MEMPOOL=y
CONFIG_ESP_HOSTED_MAX_SIMULTANEOUS_SYNC_RPC_REQUESTS=5
CONFIG_ESP_HOSTED_MAX_SIMULTANEOUS_ASYNC_RPC_REQUESTS=5

#
# Data path options
#
CONFIG_ESP_HOSTED_HOST_TO_ESP_WIFI_DATA_THROTTLE=y
CONFIG_ESP_HOSTED_PRIV_WIFI_TX_SDIO_HIGH_THRESHOLD=80
CONFIG_ESP_HOSTED_TO_WIFI_DATA_THROTTLE_HIGH_THRESHOLD=80
CONFIG_ESP_HOSTED_TO_WIFI_DATA_THROTTLE_LOW_THRESHOLD=60
# end of Data path options
# end of ESP-Hosted config

#
# Wi-Fi Remote
#
CONFIG_ESP_WIFI_REMOTE_ENABLED=y
CONFIG_SLAVE_IDF_TARGET_ESP32C6=y
CONFIG_SLAVE_SOC_WIFI_SUPPORTED=y
CONFIG_SLAVE_SOC_WIFI_WAPI_SUPPORT=y
CONFIG_SLAVE_SOC_WIFI_CSI_SUPPORT=y
CONFIG_SLAVE_SOC_WIFI_MESH_SUPPORT=y
CONFIG_SLAVE_SOC_WIFI_LIGHT_SLEEP_CLK_WIDTH=12
CONFIG_SLAVE_SOC_WIFI_HW_TSF=y
CONFIG_SLAVE_SOC_WIFI_FTM_SUPPORT=y
CONFIG_SLAVE_FREERTOS_UNICORE=y
CONFIG_SLAVE_SOC_WIFI_GCMP_SUPPORT=y
CONFIG_SLAVE_IDF_TARGET_ARCH_RISCV=y
CONFIG_SLAVE_SOC_WIFI_HE_SUPPORT=y
CONFIG_SLAVE_SOC_WIFI_MAC_VERSION_NUM=2
CONFIG_ESP_WIFI_REMOTE_LIBRARY_HOSTED=y

#
# Wi-Fi configuration
#
CONFIG_WIFI_RMT_STATIC_RX_BUFFER_NUM=16
CONFIG_WIFI_RMT_DYNAMIC_RX_BUFFER_NUM=64
CONFIG_WIFI_RMT_STATIC_TX_BUFFER=y
CONFIG_WIFI_RMT_TX_BUFFER_TYPE=0
CONFIG_WIFI_RMT_STATIC_TX_BUFFER_NUM=16
CONFIG_WIFI_RMT_CACHE_TX_BUFFER_NUM=32
CONFIG_WIFI_RMT_STATIC_RX_MGMT_BUFFER=y
CONFIG_WIFI_RMT_DYNAMIC_RX_MGMT_BUF=0
CONFIG_WIFI_RMT_RX_MGMT_BUF_NUM_DEF=5
CONFIG_WIFI_RMT_AMPDU_TX_ENABLED=y
CONFIG_WIFI_RMT_TX_BA_WIN=6
CONFIG_WIFI_RMT_AMPDU_RX_ENABLED=y
CONFIG_WIFI_RMT_RX_BA_WIN=32
CONFIG_WIFI_RMT_NVS_ENABLED=y
CONFIG_WIFI_RMT_SOFTAP_BEACON_MAX_LEN=752
CONFIG_WIFI_RMT_MGMT_SBUF_NUM=32
CONFIG_WIFI_RMT_IRAM_OPT=y
CONFIG_WIFI_RMT_RX_IRAM_OPT=y
CONFIG_WIFI_RMT_ENABLE_WPA3_SAE=y
CONFIG_WIFI_RMT_ENABLE_SAE_PK=y
CONFIG_WIFI_RMT_SOFTAP_SAE_SUPPORT=y
CONFIG_WIFI_RMT_ENABLE_WPA3_OWE_STA=y
CONFIG_WIFI_RMT_SLP_DEFAULT_MIN_ACTIVE_TIME=50
CONFIG_WIFI_RMT_SLP_DEFAULT_MAX_ACTIVE_TIME=10
CONFIG_WIFI_RMT_SLP_DEFAULT_WAIT_BROADCAST_DATA_TIME=15
CONFIG_WIFI_RMT_STA_DISCONNECTED_PM_ENABLE=y
CONFIG_WIFI_RMT_GMAC_SUPPORT=y
CONFIG_WIFI_RMT_SOFTAP_SUPPORT=y
CONFIG_WIFI_RMT_ESPNOW_MAX_ENCRYPT_NUM=7
CONFIG_WIFI_RMT_MBEDTLS_CRYPTO=y
CONFIG_WIFI_RMT_MBEDTLS_TLS_CLIENT=y
CONFIG_WIFI_RMT_TX_HETB_QUEUE_NUM=3

CONFIG_CAMERA_SC2336=y
CONFIG_CAMERA_SC2336_AUTO_DETECT=y
CONFIG_CAMERA_SC2336_AUTO_DETECT_MIPI_INTERFACE_SENSOR=y
CONFIG_CAMERA_SC2336_MIPI_RAW8_1280X720_30FPS=y
CONFIG_CAMERA_SC2336_MIPI_IF_FORMAT_INDEX_DAFAULT=9
CONFIG_CAMERA_SC2336_DVP_RAW10_1280X720_30FPS=y
CONFIG_CAMERA_SC2336_DVP_IF_FORMAT_INDEX_DAFAULT=12
CONFIG_CAMERA_SC2336_ABSOLUTE_GAIN_LIMIT=66016
CONFIG_CAMERA_SC2336_DIG_GAIN_PRIORITY=y
CONFIG_CAMERA_SC2336_DEFAULT_IPA_JSON_CONFIGURATION_FILE=y
```
