/**
 * @file board_test_s3_p4.c
 **/

#include "board_test.h"
#include "sdkconfig.h"
#include "module/console/dbg/debug_console.h"

#if (CONFIG_IDF_TARGET_ESP32S3 && !CONFIG_SLD_C_W_S3_BT817) || CONFIG_IDF_TARGET_ESP32P4

//-----------------------------------------------------------------------------------------------------------------------------------------------------------
// Internal definitions
//-----------------------------------------------------------------------------------------------------------------------------------------------------------


//-----------------------------------------------------------------------------------------------------------------------------------------------------------
// Internal structures and enums
//-----------------------------------------------------------------------------------------------------------------------------------------------------------


//-----------------------------------------------------------------------------------------------------------------------------------------------------------
// Prototypes
//-----------------------------------------------------------------------------------------------------------------------------------------------------------

/**
 * @brief Callback function that is called upon "test start" to disable the logic of the application.
 * 
 * @param obj           Custom object pointer from debug_console_test_t.
 * @param data          Pointer to the console.
 * @param args          List of arguments.
 * @param args_len      Number of arguments.
 */
static void _dbc_test_handle(void* obj, console_data_t* data, char** args, uint8_t args_len);

//-----------------------------------------------------------------------------------------------------------------------------------------------------------
// Internal variables
//-----------------------------------------------------------------------------------------------------------------------------------------------------------

/// Handler for test start.
static debug_console_test_t _dbc_test;

//-----------------------------------------------------------------------------------------------------------------------------------------------------------
// External functions
//-----------------------------------------------------------------------------------------------------------------------------------------------------------

void board_test_init(void)
{
    debug_console_register_test_callback(&_dbc_test, NULL, _dbc_test_handle);
}

//-----------------------------------------------------------------------------------------------------------------------------------------------------------
// Internal functions
//-----------------------------------------------------------------------------------------------------------------------------------------------------------

static void _dbc_test_handle(void* obj, console_data_t* data, char** args, uint8_t args_len)
{
#if CONFIG_IDF_TARGET_ESP32S3
    // Reset all I/O to use them as GPIO in test
    for(int i = 1; i < 22; i++)
    {
        mcu_io_reset(i);
    }
    for(int i = 39; i < 43; i++)
    {
        mcu_io_reset(i);
    }
    for(int i = 45; i < 49; i++)
    {
        mcu_io_reset(i);
    }
#elif CONFIG_IDF_TARGET_ESP32P4
    // I/O connector
    mcu_io_reset(47);
    mcu_io_reset(48);
    mcu_io_reset(49);
#endif
}

#endif